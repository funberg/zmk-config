#include <behaviors.dtsi>
#include <dt-bindings/zmk/keys.h>
#include "keymap_swedish.h"

#define STR(X) #X
#define XSTR(X) STR(X)

#define MODMORPH(NAME, MODS, KEY1, KEY2) \
        /omit-if-no-ref/ ##NAME: mod_morph_##NAME { \
            compatible = "zmk,behavior-mod-morph";\
            label = XSTR(MOD_MORPH_##NAME);\
            #binding-cells = <0>;\
            bindings = <KEY1>, <KEY2>;\
            mods = <(MODS)>;\
        }


/ {
    behaviors {
        MODMORPH(us_dot, MOD_LSFT|MOD_LSFT, &kp SE_DOT, &kp SE_RABK);
        MODMORPH(us_comma, MOD_LSFT|MOD_LSFT, &kp SE_COMM, &kp SE_LABK);
        MODMORPH(us_comma_mac, MOD_LSFT|MOD_LSFT, &kp SE_COMM, &kp SE_LABK_MAC);
        MODMORPH(us_slash, MOD_LSFT|MOD_LSFT, &kp SE_SLSH, &kp SE_QUES);
        MODMORPH(us_scln, MOD_LSFT|MOD_LSFT, &kp SE_SCLN, &kp SE_COLN);
        MODMORPH(us_quot, MOD_LSFT|MOD_LSFT, &kp SE_QUOT, &kp SE_DQUO);
    };
};
