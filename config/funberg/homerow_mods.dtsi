#include <behaviors.dtsi>
#include <dt-bindings/zmk/keys.h>
#include "keymap_swedish.h"

/*
 0  1  2  3  4     5  6  7  8  9
10 11 12 13 14    15 16 17 18 19
20 21 22 23 24    25 26 27 28 29
      30 31 32    33 34 35
*/

#define LEFT_KEYS_42  0 1 2 3 4 10 11 12 13 14 20 21 22 23 24 30 31 32
#define RIGHT_KEYS_42 5 6 7 8 9 15 16 17 18 19 25 26 27 28 29 33 34 35
#define STR(X) #X
#define XSTR(X) STR(X)

#define HOMEROWMODS(NAME, TRIGGER_KEYS) \
    HOMEROWMODS2(NAME, TRIGGER_KEYS, &kp)

#define HOMEROWMODS2(NAME, TRIGGER_KEYS, KEY) \
        /omit-if-no-ref/ ##NAME: homerow_mods_##NAME { \
            compatible = "zmk,behavior-hold-tap";\
            label = XSTR(HOMEROW_MODS_##NAME);\
            #binding-cells = <2>;\
            flavor = "balanced";\
            tapping-term-ms = <200>;\
            /*quick-tap-ms = <200>;*/\
            /*retro-tap;*/\
            bindings = <&kp>, <KEY>;\
            hold-trigger-key-positions = <TRIGGER_KEYS>;\
            hold-trigger-on-release;\
        }


/ {
    behaviors {
        HOMEROWMODS(lhm, RIGHT_KEYS_42);
        HOMEROWMODS(rhm, LEFT_KEYS_42);
        HOMEROWMODS2(rhm_scln, LEFT_KEYS_42, &us_scln);
    };
};
