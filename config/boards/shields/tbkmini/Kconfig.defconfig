## config/boards/shields/tbkmini/Kconfig.defconfig
```kconfig
if SHIELD_TBKMINI_LEFT
config ZMK_KEYBOARD_NAME
	default "TBK Mini"
config ZMK_SPLIT_BLE_ROLE_CENTRAL
	default y
endif

if SHIELD_TBKMINI_LEFT || SHIELD_TBKMINI_RIGHT
config ZMK_SPLIT
	default y
endif
```

## config/boards/shields/tbkmini/Kconfig.shield
```kconfig
# Copyright (c) 2020 Pete Johanson
# SPDX-License-Identifier: MIT

config SHIELD_TBKMINI_LEFT
	def_bool $(shields_list_contains,tbkmini_left)

config SHIELD_TBKMINI_RIGHT
	def_bool $(shields_list_contains,tbkmini_right)
```
